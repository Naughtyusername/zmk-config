#include <behaviors.dtsi>
#include <dt-bindings/zmk/keys.h>
#include <dt-bindings/zmk/bt.h>

// 1. Load the physical mapping for this board
#include "corne_wrapper.h"

// 2. (Optional) Put Corne-specific overrides here
// Example: If you want a specific combo only on the Corne
/ {
    chosen {
        zmk,matrix_transform = &default_transform;
    };
};

// 3. Load the master layout
#include "master_layout.dtsi"
