// clang-format off
// config/wrappers.dtsi
#include <dt-bindings/zmk/bt.h>

/* Copyright 2025 naughtyusername
 * SPDX-License-Identifier: GPL-2.0-or-later
 *
 * wrappers.h - Layout wrapper macros
 * COPIED from qmk - most the comments are qmk related. will update over time
 * This file defines reusable layout "building blocks" that can be combined
 * differently for each keyboard. The idea is:
 *
 *   1. Define your CORE layout (the 3x5 alpha grid) once
 *   2. Define keyboard-specific "wrappers" that add thumb keys
 *   3. Each keymap.c just assembles the pieces
 *
 * HOW IT WORKS:
 * -------------
 * C preprocessor macros are expanded in multiple passes. This lets us do:
 *
 *   LAYOUT_mitosis_wrapper(
 *       ___BASE_L1___, ___BASE_R1___,   // Expands to: KC_Q), KC_W, ...
 *       ...
 *   )
 *
 * The wrapper macro passes everything to the real LAYOUT() macro.
 */


#define BASE       0  // Where we spend most our time
#define VIM        1  // VIMIUM keys. home row mod free
#define LOWER      2  // NUMBERS
#define RAISE      3  // SYMBOLS
#define FUNC       4  // FUNCTIONS and NAV
#define ADJUST     5  // Keyboard adjustments and layer director, caps/num lock
#define GAMING     6  // GAMES
#define GAMING2    7  // GAMES EXPANDED
#define ROGUELIKE  8  // ROGUELIKE games, the ones that hate vim (also hard to vi key on a spiit kb on diagonal rl's) #define SYS        9            // SYSTEM bluetooth connection center, system reboot, bootloader.
#define SYS        9
#define MOUSE      10 // MOUSE keys, we dont really use. maybe on corne with trackpad.

// alias
#define _______ &trans
#define XXX &none

// --- Home Row Mod Aliases ---
// Format: &hm <Modifier> <Key>
#define HM_A &hml LGUI A
#define HM_S &hml LALT S
#define HM_D &hml LCTRL D
#define HM_F &hml LSHFT F

#define HM_J &hmr RSHFT J
#define HM_K &hmr RCTRL K
#define HM_L &hmr RALT L
#define HM_SCLN &hmr RGUI SEMI

// --- Mouse Key Aliases ---
// Requires: #include <dt-bindings/zmk/mouse.h> in your keymap
// Movement: &mmv MOVE_UP, MOVE_DOWN, MOVE_LEFT, MOVE_RIGHT
// Scroll: &msc SCRL_UP, SCRL_DOWN, SCRL_LEFT, SCRL_RIGHT
// Buttons: &mkp MB1 (left), MB2 (right), MB3 (middle)


/* ==========================================================================
 * 5-COLUMN MACROS (for 3x5 splits like the core of your layout)
 * ==========================================================================
 * These are your BASE rows - the 3x5 grid that's common to all boards.
 * Each macro is ONE ROW (5 keys) for either left (L) or right (R) hand.
 *
 * Naming convention: ___LAYER_ROW_SIDE___
 *   - Layer: BASE, LOWER, RAISE, etc.
 *   - Row: 1 (top), 2 (home), 3 (bottom)
 *   - Side: L (left), R (right)
 *
 * The triple underscores are just a visual convention (from Drashna) to make
 * it obvious these are wrapper macros, not regular defines.
 */

/* --------------------------------------------------------------------------
 * BASE LAYER - QWERTY with Home Row Mods
 * --------------------------------------------------------------------------
 *  Q     W     E     R     T          Y     U     I     O     P
 * A/Gui S/Alt D/Ctl F/Sft  G          H    J/Sft K/Ctl L/Alt ;/Gui
 * Z/sys X     C     V      B          N     M     ,     .     /
 */

// Alphas
#define ___BASE_L1___ &kp Q &kp W &kp E &kp R &kp T
#define ___BASE_L2___ HM_A HM_S HM_D HM_F &kp G
#define ___BASE_L3___ &lt_1s_mo SYS Z &kp X &kp C &kp V &lt LOWER B

#define ___BASE_R1___ &kp Y &kp U &kp I &kp O &kp P
#define ___BASE_R2___ &kp H HM_J HM_K HM_L HM_SCLN
#define ___BASE_R3___ &lt RAISE N &kp M &kp COMMA &kp DOT &lt_1s_mo SYS SLASH

/* --------------------------------------------------------------------------
 * VIM LAYER - Plain QWERTY without Home Row Mods
 * --------------------------------------------------------------------------
 * For Vimium browser extension, vim modes in editors, etc.
 * One-shot mods available via combos: GACS on QW/WE/ER/RT (left) and YU/UI/IO/OP (right)
 *    GUI   ALT   CTL   SHFT             SHFT  CTRL  ALT   GUI
 *  Q<--->W<--->E<--->R<--->T          Y<--->U<--->I<--->O<--->P
 *  A     S     D     F     G          H     J     K     L     ;
 *  Z     X     C     V     B          N     M     ,     .     /
 */
#define ___VIM_L1___ &kp Q &kp W &kp E &kp R &kp T
#define ___VIM_L2___ &kp A &kp S &kp D &kp F &kp G
#define ___VIM_L3___ &kp Z &kp X &kp C &kp V &kp B

#define ___VIM_R1___ &kp Y &kp U &kp I &kp O &kp P
#define ___VIM_R2___ &kp H &kp J &kp K &kp L &kp SEMI
#define ___VIM_R3___ &kp N &kp M &kp COMMA &kp DOT &kp FSLH

/* --------------------------------------------------------------------------
 * RAISE LAYER - Symbols (Odin/Programming focused)
 * --------------------------------------------------------------------------
 *  \     $     |     -     [          ]     +     #     ;     ::
 *  ~     &     *     =     (          )     ^     _     %     :
 *  `     !     '     "     {          }     @     <     >     ?
 */
#define ___RAISE_L1___ &kp BSLH  &kp DLLR &kp PIPE &kp MINUS &kp LBKT
#define ___RAISE_L2___ &kp TILDE &kp AMPS &kp STAR &kp EQUAL &kp LPAR
#define ___RAISE_L3___ &kp GRAVE &kp EXCL &kp SQT  &kp DQT   &kp LBRC

#define ___RAISE_R1___ &kp RBKT &kp PLUS  &kp HASH  &kp SEMI  &double_colon
#define ___RAISE_R2___ &kp RPAR &kp CARET &kp UNDER &kp PRCNT &kp COLON
#define ___RAISE_R3___ &kp RBRC &kp AT    &kp LT    &kp GT    &kp QMARK

/* --------------------------------------------------------------------------
 * LOWER LAYER - Numbers and Media
 * --------------------------------------------------------------------------
 *  1     2     3     4     5          6     7     8     9     0
 *  _     %    Vol+  Vol-  Mute        .     4     5     6     ,
 *  *     /    Prev  Play  Next        +     1     2     3     -
 */
#define ___LOWER_L1___ &kp N1    &kp N2       &kp N3       &kp N4       &kp N5
#define ___LOWER_L2___ &kp UNDER &kp PERCENT  &kp C_VOL_UP &kp C_VOL_DN &kp C_MUTE
#define ___LOWER_L3___ &kp STAR  &kp FSLH     &kp C_PREV   &kp C_PP     &kp C_NEXT

#define ___LOWER_R1___ &kp N6   &kp N7 &kp N8 &kp N9 &kp N0
#define ___LOWER_R2___ &kp DOT  &kp N4 &kp N5 &kp N6 &kp COMMA
#define ___LOWER_R3___ &kp PLUS &kp N1 &kp N2 &kp N3 &kp MINUS

/* --------------------------------------------------------------------------
 * FUNC LAYER - F-keys and Navigation
 * --------------------------------------------------------------------------
 *  F9   F10   F11   F12   PrtSc       PgUp  Home  End   Ins    _
 *  F5   F6    F7    F8     _          Left  Down  Up    Right  _
 *  F1   F2    F3    F4     _          PgDn   _     _     _      _
 */
#define ___FUNC_L1___ &kp F9 &kp F10 &kp F11 &kp F12 &kp PSCRN
#define ___FUNC_L2___ &kp F5 &kp F6 &kp F7 &kp F8    XXX
#define ___FUNC_L3___ &kp F1 &kp F2 &kp F3 &kp F4    XXX

#define ___FUNC_R1___ &kp PG_UP &kp HOME &kp END &kp INS   &kp DEL
#define ___FUNC_R2___ &kp LEFT  &kp DOWN &kp UP  &kp RIGHT XXX
#define ___FUNC_R3___ &kp PG_DN XXX      XXX      XXX      XXX

/* --------------------------------------------------------------------------
 * ADJUST LAYER - System (Tri-layer: LOWER + RAISE)
 * --------------------------------------------------------------------------
 * Base  Game  Rogue  Vim   capslock            _     _     _     _    _
 *  _     _     _     _     numlock             _     _     _     _    _
 *  _     _     _     _     _            _     _     _     _    _
 */
#define ___ADJUST_L1___ &tog BASE &tog GAMING   _______ _______ &kp CAPS
#define ___ADJUST_L2___ _______ _______ _______ _______         &kp KP_NUM
#define ___ADJUST_L3___ _______ _______ _______ _______         _______

#define ___ADJUST_R1___ _______ _______ _______ _______ _______
#define ___ADJUST_R2___ _______ _______ _______ _______ _______
#define ___ADJUST_R3___ _______ _______ _______ _______ _______

/* --------------------------------------------------------------------------
 * GAMING LAYER - No home row mods standard QWERTY - escapes to base, gaming2, roguelike
 * --------------------------------------------------------------------------
 *  Q     W     E     R     T          Y     U     I     O     P
 *  A     S     D     F     G          H     J     K     L     ;
 *  Z     X     C     V     B          N     M     ,     .     /
 */
#define ___GAMING_L1___ &kp Q &kp W &kp E &kp R &kp T
#define ___GAMING_L2___ &kp A &kp S &kp D &kp F &kp G
#define ___GAMING_L3___ &kp Z &kp X &kp C &kp V &kp B

#define ___GAMING_R1___ &kp Y &kp U &kp I &kp O &kp P
#define ___GAMING_R2___ &kp H &kp J &kp K &kp L &kp SEMI
#define ___GAMING_R3___ &kp N &kp M &kp COMMA &kp DOT &kp FSLH

/* --------------------------------------------------------------------------
 * GAMING2 LAYER - F-keys and Numbers (for boards without numrow like Cradio)
 * --------------------------------------------------------------------------
 *  1     2     3     4     5          6     7     8     9     0
 *  F1    F2    F3    F4    F5         F6    F7    F8    F9    F10
 *  F11   F12   _     _     PrtSc      _     _     _     _     _
 */
#define ___GAMING2_L1___ &kp N1 &kp N2 &kp N3 &kp N4 &kp N5
#define ___GAMING2_L2___ &kp F1 &kp F2 &kp F3 &kp F4 &kp F5
#define ___GAMING2_L3___ &kp F11 &kp F12 _______ _______ &kp PSCRN

#define ___GAMING2_R1___ &kp N6 &kp N7 &kp N8 &kp N9 &kp N0
#define ___GAMING2_R2___ &kp F6 &kp F7 &kp F8 &kp F9 &kp F10
#define ___GAMING2_R3___ _______ _______ _______ _______ _______

/* --------------------------------------------------------------------------
 * ROGUELIKE LAYER - Extension of Gaming layer - Numpad on right, escape codes back to
 gaming 1 possibly gaming 2?
 * --------------------------------------------------------------------------
 *  Q(comboESC) W     E     R     T        Y     7     8     9     _
 *  A           S     D     F     G        .     4     5     6     _
 *  Z           X     X     C     B        N     1     2     3     _
 */
#define ___ROGUELIKE_L1___ &kp Q &kp W &kp E &kp R &kp T
#define ___ROGUELIKE_L2___ &kp A &kp S &kp D &kp F &kp G
#define ___ROGUELIKE_L3___ &kp Z &kp X &kp C &kp V &kp B

#define ___ROGUELIKE_R1___ &kp Y       &kp KP_N7  &kp KP_N8  &kp KP_N9 XXX
#define ___ROGUELIKE_R2___ &kp KP_DOT  &kp KP_N4  &kp KP_N5  &kp KP_N6 XXX
#define ___ROGUELIKE_R3___ &kp N       &kp KP_N1  &kp KP_N2  &kp KP_N3 XXX

/* --------------------------------------------------------------------------
 * SYS LAYER - Bluetooth connections, clearing, reboot bootloader
 * --------------------------------------------------------------------------
 *  btCLEAR btZERO btONE btTWO btTHREE         _     _     _        _         _
 *  bootloader system reset  _     _           _     _     _  sys_reset bootloader
 *  holding  tog-base  _     _     _           _     _     _        _    holding
 */
#define ___SYS_L1___ &bt BT_CLR_ALL &bt BT_SEL 0 &bt BT_SEL 1 &bt BT_SEL 2 &bt BT_SEL 3
#define ___SYS_L2___ &bootloader &sys_reset    _______ _______ _______
#define ___SYS_L3___ _______ &tog BASE  _______ _______ _______

#define ___SYS_R1___ _______ _______ _______ _______ _______
#define ___SYS_R2___ _______ _______ _______ &sys_reset &bootloader
#define ___SYS_R3___ _______ _______ _______ _______ _______

/* --------------------------------------------------------------------------
 * MOUSE LAYER - Mouse keys for trackpad-less navigation
 * --------------------------------------------------------------------------
 * Movement mirrored on both hands (WASD left, HJKL-style right)
 * Scroll on left hand, buttons on both sides
 *
 *  Scrl_L Scrl_U Scrl_D Scrl_R  _         _    MsUp    _      _     _
 *  MsLft  MsDn   MsUp   MsRt   Btn3       Btn3 MsLft  MsDn   MsRt   _
 *   _     Btn1   Btn2   Btn3    _         _    Btn1   Btn2   Btn3   _
 */
#define ___MOUSE_L1___ &msc SCRL_LEFT &msc SCRL_UP   &msc SCRL_DOWN &msc SCRL_RIGHT XXX
#define ___MOUSE_L2___ &mmv MOVE_LEFT &mmv MOVE_DOWN &mmv MOVE_UP   &mmv MOVE_RIGHT &mkp MB3
#define ___MOUSE_L3___ XXX &mkp MB1 &mkp MB2 &mkp MB3 XXX

#define ___MOUSE_R1___ XXX &mmv MOVE_UP XXX XXX XXX
#define ___MOUSE_R2___ &mkp MB3 &mmv MOVE_LEFT &mmv MOVE_DOWN &mmv MOVE_RIGHT XXX
#define ___MOUSE_R3___ XXX &mkp MB1 &mkp MB2 &mkp MB3 XXX

/* --------------------------------------------------------------------------
 * BLANK TEMPLATE
 * --------------------------------------------------------------------------
 *  _     _     _     _     _          _     _     _     _     _
 *  _     _     _     _     _          _     _     _     _     _
 *  _     _     _     _     _          _     _     _     _     _
 */
#define ___BLANK_L1___ _______ _______ _______ _______ _______
#define ___BLANK_L2___ _______ _______ _______ _______ _______
#define ___BLANK_L3___ _______ _______ _______ _______ _______

#define ___BLANK_R1___ _______ _______ _______ _______ _______
#define ___BLANK_R2___ _______ _______ _______ _______ _______
#define ___BLANK_R3___ _______ _______ _______ _______ _______

// non HMR rows
#define ___BASE_NO_HRM_L2___ &kp A &kp S &kp D &kp F &kp G
#define ___BASE_NO_HRM_R2___ &kp H &kp J &kp K &kp L &kp SEMI

// --------------------------------------------------------------------------
// TOP ROW NUMBER ROW - sofle - any huge keyboard.
// --------------------------------------------------------------------------
#define ___NUM_BASE_L___      &kp N1 &kp N2 &kp N3 &kp N4 &kp N5
#define ___NUM_BASE_R___      &kp N6 &kp N7 &kp N8 &kp N9 &kp N0

#define ___NUM_LOWER_L___     &trans &trans &trans &trans &trans
#define ___NUM_LOWER_R___     &trans &trans &trans &trans &trans

#define ___NUM_RAISE_L___     &trans &trans &trans &trans &trans
#define ___NUM_RAISE_R___     &trans &trans &trans &trans &trans

#define ___NUM_FUNC_L___      &trans &trans &trans &trans &trans
#define ___NUM_FUNC_R___      &trans &trans &trans &trans &trans

#define ___NUM_ADJUST_L___    &trans &trans &trans &trans &trans
#define ___NUM_ADJUST_R___    &trans &trans &trans &trans &trans

#define ___NUM_GAMING_L___    &trans &trans &trans &trans &trans
#define ___NUM_GAMING_R___    &trans &trans &trans &trans &trans

#define ___NUM_GAMING2_L___   _______ _______ _______ _______ _______
#define ___NUM_GAMING2_R___   _______ _______ _______ _______ _______

#define ___NUM_ROGUELIKE_L___ _______ _______ _______ _______ _______
#define ___NUM_ROGUELIKE_R___ _______ _______ _______ _______ _______

#define ___NUM_SYS_L___       _______ _______ _______ _______ _______
#define ___NUM_SYS_R___       _______ _______ _______ _______ _______

#define ___NUM_VIM_L___       _______ _______ _______ _______ _______
#define ___NUM_VIM_R___       _______ _______ _______ _______ _______

#define ___NUM_MOUSE_L___     _______ _______ _______ _______ _______
#define ___NUM_MOUSE_R___     _______ _______ _______ _______ _______

// --------------------------------------------------------------------------
// TOP ROW NUMBER ROW 6 COLUMN EXPANSION - sofle - any huge keyboard.
// --------------------------------------------------------------------------
#define ___NUM_BASE_L_6___      &kp ESC ___NUM_BASE_L___
#define ___NUM_BASE_R_6___      ___NUM_BASE_R___ &kp BSPC

#define ___NUM_VIM_L_6___       _______ ___NUM_VIM_L___
#define ___NUM_VIM_R_6___       ___NUM_VIM_R___ _______

#define ___NUM_LOWER_L_6___     _______ ___NUM_LOWER_L___
#define ___NUM_LOWER_R_6___     ___NUM_LOWER_R___ _______

#define ___NUM_RAISE_L_6___     _______ ___NUM_RAISE_L___
#define ___NUM_RAISE_R_6___     ___NUM_RAISE_R___ _______

#define ___NUM_FUNC_L_6___      _______ ___NUM_FUNC_L___
#define ___NUM_FUNC_R_6___      ___NUM_FUNC_R___ _______

#define ___NUM_ADJUST_L_6___    _______ ___NUM_ADJUST_L___
#define ___NUM_ADJUST_R_6___    ___NUM_ADJUST_R___ _______

#define ___NUM_GAMING_L_6___    _______ ___NUM_GAMING_L___
#define ___NUM_GAMING_R_6___    ___NUM_GAMING_R___ _______

// --------------------------------------------------------------------------
// SOFLE-SPECIFIC GAMING2 - F-keys focused (Sofle already has number row)
// --------------------------------------------------------------------------
// Top row (number row position): F1-F5, F6-F10
// This replaces the standard GAMING2 top row for Sofle since it has numbers already
#define ___NUM_GAMING2_L_6___ &kp ESC &kp F1 &kp F2 &kp F3 &kp F4 &kp F5
#define ___NUM_GAMING2_R_6___ &kp F6 &kp F7 &kp F8 &kp F9 &kp F10 _______

#define ___NUM_ROGUELIKE_L_6___ _______ ___NUM_ROGUELIKE_L___
#define ___NUM_ROGUELIKE_R_6___ ___NUM_ROGUELIKE_R___ _______

#define ___NUM_SYS_L_6___       _______ ___NUM_SYS_L___
#define ___NUM_SYS_R_6___       ___NUM_SYS_R___ _______

#define ___NUM_MOUSE_L_6___     _______ ___NUM_MOUSE_L___
#define ___NUM_MOUSE_R_6___     ___NUM_MOUSE_R___ _______


/* --------------------------------------------------------------------------
 * SOFLE GAMING2 LAYER - F-keys focused (use instead of standard GAMING2 on Sofle)
 * --------------------------------------------------------------------------
 * Number row: F1-F10 (since Sofle already has 1-0 on GAMING)
 *
 *  F11   F12   _     _     PrtSc      _     _     _     _     _
 *  _     _     _     _     _          _     _     _     _     _
 *  _     _     _     _     _          _     _     _     _     _
 */
#define ___SOFLE_GAMING2_L1___ &kp F11 &kp F12 _______ _______ &kp PSCRN
#define ___SOFLE_GAMING2_L2___ _______ _______ _______ _______ _______
#define ___SOFLE_GAMING2_L3___ _______ _______ _______ _______ _______

#define ___SOFLE_GAMING2_R1___ _______ _______ _______ _______ _______
#define ___SOFLE_GAMING2_R2___ _______ _______ _______ _______ _______
#define ___SOFLE_GAMING2_R3___ _______ _______ _______ _______ _______

// 6-column expansion for Sofle GAMING2
#define ___SOFLE_GAMING2_L1_6___ _______ ___SOFLE_GAMING2_L1___
#define ___SOFLE_GAMING2_L2_6___ _______ ___SOFLE_GAMING2_L2___
#define ___SOFLE_GAMING2_L3_6___ _______ ___SOFLE_GAMING2_L3___

#define ___SOFLE_GAMING2_R1_6___ ___SOFLE_GAMING2_R1___ _______
#define ___SOFLE_GAMING2_R2_6___ ___SOFLE_GAMING2_R2___ _______
#define ___SOFLE_GAMING2_R3_6___ ___SOFLE_GAMING2_R3___ _______

/* ==========================================================================
 * 6-COLUMN EXPANSION MACROS
 * ==========================================================================
 * For keyboards with 6 columns per side (like Corne and sofle) we add an outer column.
 * These take the 5-column macros and add a key on each edge.
 *
 * Format: OUTER_LEFT, <5 col macro>, OUTER_RIGHT
 */
#define ___BASE_L1_6___ &kp ESC   ___BASE_L1___
#define ___BASE_L2_6___ &kp TAB   ___BASE_L2___
#define ___BASE_L3_6___ &sk LGUI  ___BASE_L3___

#define ___BASE_R1_6___ ___BASE_R1___ &kp BSPC
#define ___BASE_R2_6___ ___BASE_R2___ &kp SQT
#define ___BASE_R3_6___ ___BASE_R3___ &sk RGUI

// VIM layer with outer columns
#define ___VIM_L1_6___ &kp ESC ___VIM_L1___
#define ___VIM_L2_6___ &kp TAB ___VIM_L2___
#define ___VIM_L3_6___ _______ ___VIM_L3___

#define ___VIM_R1_6___ ___VIM_R1___ &kp BSPC
#define ___VIM_R2_6___ ___VIM_R2___ &kp SQT
#define ___VIM_R3_6___ ___VIM_R3___ &kp RET

// Raise layer with outer columns
#define ___RAISE_L1_6___ _______ ___RAISE_L1___
#define ___RAISE_L2_6___ _______ ___RAISE_L2___
#define ___RAISE_L3_6___ _______ ___RAISE_L3___

#define ___RAISE_R1_6___ ___RAISE_R1___ &kp BSLH
#define ___RAISE_R2_6___ ___RAISE_R2___ _______
#define ___RAISE_R3_6___ ___RAISE_R3___ _______

// Lower layer with outer columns
#define ___LOWER_L1_6___ _______   ___LOWER_L1___
#define ___LOWER_L2_6___ _______ ___LOWER_L2___
#define ___LOWER_L3_6___ _______ ___LOWER_L3___

#define ___LOWER_R1_6___ ___LOWER_R1___ &kp BSLH
#define ___LOWER_R2_6___ ___LOWER_R2___ _______
#define ___LOWER_R3_6___ ___LOWER_R3___ _______

// Func layer with outer columns
#define ___FUNC_L1_6___ _______ ___FUNC_L1___
#define ___FUNC_L2_6___ _______ ___FUNC_L2___
#define ___FUNC_L3_6___ _______ ___FUNC_L3___

#define ___FUNC_R1_6___ ___FUNC_R1___ _______
#define ___FUNC_R2_6___ ___FUNC_R2___ _______
#define ___FUNC_R3_6___ ___FUNC_R3___ _______

// Adjust layer with outer columns
#define ___ADJUST_L1_6___ _______ ___ADJUST_L1___
#define ___ADJUST_L2_6___ _______ ___ADJUST_L2___
#define ___ADJUST_L3_6___ _______ ___ADJUST_L3___

#define ___ADJUST_R1_6___ ___ADJUST_R1___ _______
#define ___ADJUST_R2_6___ ___ADJUST_R2___ _______
#define ___ADJUST_R3_6___ ___ADJUST_R3___ _______

// Roguelike layer with outer columns
#define ___ROGUELIKE_L1_6___ _______ ___ROGUELIKE_L1___
#define ___ROGUELIKE_L2_6___ _______ ___ROGUELIKE_L2___
#define ___ROGUELIKE_L3_6___ _______ ___ROGUELIKE_L3___

#define ___ROGUELIKE_R1_6___ ___ROGUELIKE_R1___ _______
#define ___ROGUELIKE_R2_6___ ___ROGUELIKE_R2___ _______
#define ___ROGUELIKE_R3_6___ ___ROGUELIKE_R3___ _______

// Sys layer with outer columns
#define ___SYS_L1_6___ _______ ___SYS_L1___
#define ___SYS_L2_6___ _______ ___SYS_L2___
#define ___SYS_L3_6___ _______ ___SYS_L3___

#define ___SYS_R1_6___ ___SYS_R1___ _______
#define ___SYS_R2_6___ ___SYS_R2___ _______
#define ___SYS_R3_6___ ___SYS_R3___ _______

// Gaming layer with outer columns
#define ___GAMING_L1_6___ &kp TAB ___GAMING_L1___
#define ___GAMING_L2_6___ &kp ESC ___GAMING_L2___
#define ___GAMING_L3_6___ _______ ___GAMING_L3___

#define ___GAMING_R1_6___ ___GAMING_R1___ &kp BSLH
#define ___GAMING_R2_6___ ___GAMING_R2___ &kp SQT
#define ___GAMING_R3_6___ ___GAMING_R3___ &kp RET

// Gaming2 layer with outer columns (ESC top left for boards without number row)
#define ___GAMING2_L1_6___ &kp ESC ___GAMING2_L1___
#define ___GAMING2_L2_6___ _______ ___GAMING2_L2___
#define ___GAMING2_L3_6___ _______ ___GAMING2_L3___

#define ___GAMING2_R1_6___ ___GAMING2_R1___ _______
#define ___GAMING2_R2_6___ ___GAMING2_R2___ _______
#define ___GAMING2_R3_6___ ___GAMING2_R3___ _______

// MOUSE layer with outer columns
#define ___MOUSE_L1_6___ _______ ___MOUSE_L1___
#define ___MOUSE_L2_6___ _______ ___MOUSE_L2___
#define ___MOUSE_L3_6___ _______ ___MOUSE_L3___

#define ___MOUSE_R1_6___ ___MOUSE_R1___ _______
#define ___MOUSE_R2_6___ ___MOUSE_R2___ _______
#define ___MOUSE_R3_6___ ___MOUSE_R3___ _______

/* --------------------------------------------------------------------------
 * Sofle thumb layers
 * --------------------------------------------------------------------------
 * |BASE  |  skALT      skCTL       skSHIFT     bs_del    RAISE+SPACE |  LOWER+RET   FN+TAB    skSHIFT   skCTL     skALT
                                                                      |
 * |LOWER | _______     _______     _______     _______     _______   |  _______     _______     _______     _______     _______
                                                                      |
 * |RAISE | _______     _______     _______     _______     _______   |  _______     _______     _______     _______     _______
                                                                      |
 * |FUNC  | _______     _______     _______     _______     _______   |  _______     _______     _______     _______     _______
                                                                      |
 * |ADJUST| _______     _______     _______     _______     _______   |  _______     _______     _______     _______     _______
                                                                      |
 * |ROGUE|  _______     _______     _______     _______     _______   |  _______     _______     _______     _______     _______
                                                                      |
 * |SYS   | _______     _______     _______     _______     _______   |  _______     _______     _______     _______     _______
                                                                      |
 * |GAMING| _______     _______     _______     _______     _______   |  _______     _______     _______     _______     _______
 */

// Sofle thumbs
#define ___SOFLE_THUMBS_L_BASE___ &sk LSHFT &sk LCTRL &sk LALT &bs_del &lt RAISE SPACE
#define ___SOFLE_THUMBS_R_BASE___ &lt LOWER RETURN  &lt FUNC TAB  &sk RSHFT &sk RCTRL &sk RALT

#define ___SOFLE_THUMBS_L_LOWER___ _______  _______  _______  _______  _______
#define ___SOFLE_THUMBS_R_LOWER___ _______  _______  _______  _______  _______

#define ___SOFLE_THUMBS_L_RAISE___ _______  _______  _______  _______  _______
#define ___SOFLE_THUMBS_R_RAISE___ _______  _______  _______  _______  _______

#define ___SOFLE_THUMBS_L_FUNC___ _______  _______  _______  _______  _______
#define ___SOFLE_THUMBS_R_FUNC___ _______  _______  _______  _______  _______

#define ___SOFLE_THUMBS_L_ADJUST___ _______  _______  _______  _______  _______
#define ___SOFLE_THUMBS_R_ADJUST___ _______  _______  _______  _______  _______

#define ___SOFLE_THUMBS_L_ROGUELIKE___ _______  _______  _______  _______  _______
#define ___SOFLE_THUMBS_R_ROGUELIKE___ _______  _______  _______  _______  _______

#define ___SOFLE_THUMBS_L_SYS___ _______  _______  _______  _______  _______
#define ___SOFLE_THUMBS_R_SYS___ _______  _______  _______  _______  _______

#define ___SOFLE_THUMBS_L_GAMING___ _______  _______  _______  &kp BSPC  &kp SPACE
#define ___SOFLE_THUMBS_R_GAMING___ &kp RET  &lt GAMING2 TAB  _______  _______  _______

#define ___SOFLE_THUMBS_L_GAMING2___ _______  _______  _______  _______  _______
#define ___SOFLE_THUMBS_R_GAMING2___ _______  _______  _______  _______  _______

#define ___SOFLE_THUMBS_L_VIM___ _______  _______  _______  _______  _______
#define ___SOFLE_THUMBS_R_VIM___ _______  _______  _______  _______  _______

#define ___SOFLE_THUMBS_L_MOUSE___ _______  _______  _______  _______  _______
#define ___SOFLE_THUMBS_R_MOUSE___ _______  _______  _______  _______  _______

// Sofle encoder rotation bindings
#define ___ENC_BASE___         &inc_dec_kp C_VOL_UP C_VOL_DN    &inc_dec_kp PG_UP PG_DN
#define ___ENC_LOWER___        &inc_dec_kp C_VOL_UP C_VOL_DN    &inc_dec_kp PG_UP PG_DN
#define ___ENC_RAISE___        &inc_dec_kp C_VOL_UP C_VOL_DN    &inc_dec_kp PG_UP PG_DN
#define ___ENC_FUNC___         &inc_dec_kp C_VOL_UP C_VOL_DN    &inc_dec_kp PG_UP PG_DN
#define ___ENC_ADJUST___       &inc_dec_kp C_VOL_UP C_VOL_DN    &inc_dec_kp PG_UP PG_DN
#define ___ENC_GAMING___       &inc_dec_kp C_VOL_UP C_VOL_DN    &inc_dec_kp PG_UP PG_DN
#define ___ENC_GAMING2___      &inc_dec_kp C_VOL_UP C_VOL_DN    &inc_dec_kp PG_UP PG_DN
#define ___ENC_ROGUELIKE___    &inc_dec_kp C_VOL_UP C_VOL_DN    &inc_dec_kp PG_UP PG_DN
#define ___ENC_SYS___          &inc_dec_kp C_VOL_UP C_VOL_DN    &inc_dec_kp PG_UP PG_DN
#define ___ENC_VIM___          &inc_dec_kp C_VOL_UP C_VOL_DN    &inc_dec_kp PG_UP PG_DN
#define ___ENC_MOUSE___        &inc_dec_kp C_VOL_UP C_VOL_DN    &inc_dec_kp PG_UP PG_DN

// Encoder Button bindings - this particular setup works for any keyboard where they are paralel
// on the same row.
#define ___ENC_KEY_BASE___   XXX &kp C_MUTE
#define ___ENC_KEY_LOWER___  _______ _______
#define ___ENC_KEY_RAISE___  _______ _______
#define ___ENC_KEY_FUNC___   _______ _______
#define ___ENC_KEY_ADJUST___ _______ _______
#define ___ENC_KEY_GAMING___ _______ _______
#define ___ENC_KEY_GAMING2___ _______ _______
#define ___ENC_KEY_ROGUELIKE___ _______ _______
#define ___ENC_KEY_SYS___       _______ _______
#define ___ENC_KEY_VIM___       _______ _______
#define ___ENC_KEY_MOUSE___     _______ _______

/* --------------------------------------------------------------------------
 * Sweep thumb layers // TODO no idea if we should add anythign on the adjust layer, but its an option
 * --------------------------------------------------------------------------
 *  BACKSPACE+DELETE     RAISE+SPACE  |BASE  |   LOWER+RETURN    FUNC+TAB
 *  -----------          -----------  |LOWER |   HOLDING         -----------
 *  -----------          HOLDING      |RAISE |   -----------     -----------
 *  TAB                  SPACE        |FUNC  |   RETURN          HOLDING
 *  -----------          HOLDING      |ADJUST|   HOLDING         -----------
 *  BACKSPACE            SPACE        |GAMING|   RETURN          TAB
 */
// Sweep / Cradio Thumbs
#define ___SWEEP_THUMBS_BASE___        &bs_del  &lt RAISE SPACE      &lt LOWER RETURN  &lt FUNC TAB
#define ___SWEEP_THUMBS_LOWER___       _______  _______                _______  _______
#define ___SWEEP_THUMBS_RAISE___       _______  _______                _______  _______
#define ___SWEEP_THUMBS_FUNC___        &kp TAB  &kp SPACE            &kp RETURN  _______
#define ___SWEEP_THUMBS_ADJUST___      _______  _______                _______  _______
#define ___SWEEP_THUMBS_ROGUELIKE___   _______  _______                _______  _______
#define ___SWEEP_THUMBS_SYS___         _______  _______                _______  _______
#define ___SWEEP_THUMBS_GAMING___      &kp BSPC  &kp SPACE           &kp RETURN  &kp TAB
#define ___SWEEP_THUMBS_GAMING2___     _______  _______              _______  _______
#define ___SWEEP_THUMBS_VIM___         _______  _______              _______  _______
#define ___SWEEP_THUMBS_MOUSE___       _______  _______              _______  _______
