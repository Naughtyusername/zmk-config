// base_keymap.dtsi
ZMK_LAYER(default,
    LAYOUT_36(
        &kp Q, &kp W, &kp E, &kp R, &kp T,    &kp Y, &kp U, &kp I, &kp O, &kp P,
        &kp A, &kp S, &kp D, &kp F, &kp G,    &kp H, &kp J, &kp K, &kp L, &kp SEMI,
        &kp Z, &kp X, &kp C, &kp V, &kp B,    &kp N, &kp M, &kp COMMA, &kp DOT, &kp SLASH,
                      &kp LGUI, &mo 1, &kp SPC, &kp RET, &mo 2, &kp RALT
    )
)
